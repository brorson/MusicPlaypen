/dts-v1/;
/plugin/;

/ {
   compatible = "ti,beaglebone", "ti,beaglebone-black";

   part-number = "ADC_001";
   version = "00A0";

   exclusive-use =
          "P9.27", 
          "P9.28",
          "P9.29",
          "P9.30",
          "pru0",
          "P8.27",
          "pru1";

   fragment@0 {
      target = <&am33xx_pinmux>;
      __overlay__ {

         pru_pru_pins: pinmux_pru_pru_pins {
            pinctrl-single,pins = <
               0x1a4 0x05  // SCK  P9_27 pr1_pru0_pru_r30_5, MODE5 | OUTPUT
               0x19c 0x05  // CS   P9_28 pr1_pru0_pru_r30_3, MODE5 | OUTPUT
               0x194 0x05  // MOSI P9_29 pr1_pru0_pru_r30_1, MODE5 | OUTPUT
               0x198 0x26  // MISO P29_30 pr1_pru0_pru_r31_2, MODE6 | INPUT
               0x0e0 0x05  // TRIG P8_27 pr1_pru1_pru_r30_8, MODE5 | OUTPUT
            >;
         };
      };
   };

   fragment@1 {  
      target = <&pruss>;
      __overlay__ {
         status = "okay";
         pinctrl-names = "default";
         pinctrl-0 = <&pru_pru_pins>;
      };
   };

};
